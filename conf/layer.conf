## conf/layer.conf
```bitbake
# We might have a conf and classes directory, append to BBPATH
BBPATH .= ":${LAYERDIR}"

# We have recipes directories, add to BBFILES
BBFILES += "${LAYERDIR}/recipes*/*/*.bb ${LAYERDIR}/recipes*/*/*.bbappend"

BBFILE_COLLECTIONS += "meta-updatefactory"
BBFILE_PATTERN_meta-updatefactory := "^${LAYERDIR}/"
BBFILE_PRIORITY_meta-updatefactory = "9"

LAYERDEPENDS_meta-updatefactory = "swupdate"
LAYERSERIES_COMPAT_meta-updatefactory = "kirkstone"

BBFILES_DYNAMIC += " \
    fsl-arm-extra:${LAYERDIR}/dynamic-layers/fsl-arm-extra/*/*/*.bb \
    fsl-arm-extra:${LAYERDIR}/dynamic-layers/fsl-arm-extra/*/*/*.bbappend \
    \
    boundary-layer:${LAYERDIR}/dynamic-layers/boundary-layer/*/*/*.bbappend \
    boundary-layer:${LAYERDIR}/dynamic-layers/boundary-layer/*/*/*.bb \
    \
    raspberrypi:${LAYERDIR}/dynamic-layers/raspberrypi/*/*/*.bbappend \
    raspberrypi:${LAYERDIR}/dynamic-layers/raspberrypi/*/*/*.bb \
    \
    toradex-bsp-common-layer:${LAYERDIR}/dynamic-layers/toradex-bsp-common-layer/*/*/*.bbappend \
    toradex-bsp-common-layer:${LAYERDIR}/dynamic-layers/toradex-bsp-common-layer/*/*/*.bb \
    \
    toradex-nxp-layer:${LAYERDIR}/dynamic-layers/toradex-nxp-layer/*/*/*.bbappend \
    toradex-nxp-layer:${LAYERDIR}/dynamic-layers/toradex-nxp-layer/*/*/*.bb \
"
```

## scripts/lib/wic/canned-wks/recovery-with-updates.wks
```
# short-description: recovery partition
# long-description: recovery partition with space for recovery boot files and
# to store the update files.

part /recovery --source filescopy --fixed-size ${UF_UPDATES_PART_SIZE} --fstype=ext4 --label recovery --use-label --align 4
```

## scripts/lib/wic/canned-wks/recovery.wks
```
# short-description: recovery partition
# long-description: recovery partition with space for recovery boot files

part --source filescopy --fixed-size 100 --fstype=ext4 --label recovery --align 4
```

## scripts/lib/wic/canned-wks/updates.wks
```
# short-description: updates partition
# long-description: updates partition with space to store the update files.

part /recovery/updates --fixed-size ${UF_UPDATES_PART_SIZE} --fstype=ext4 --label updates --use-label --align 4
```
